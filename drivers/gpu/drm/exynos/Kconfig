## drivers/gpu/drm/exynos/Kconfig
```kconfig
config DRM_EXYNOS
	tristate "DRM Support for Samsung SoC EXYNOS Series"
	depends on DRM && PLAT_SAMSUNG
	select DRM_KMS_HELPER
	select FB_CFB_FILLRECT
	select FB_CFB_COPYAREA
	select FB_CFB_IMAGEBLIT
	select VT_HW_CONSOLE_BINDING if FRAMEBUFFER_CONSOLE
	help
	  Choose this option if you have a Samsung SoC EXYNOS chipset.
	  If M is selected the module will be called exynosdrm.

config DRM_EXYNOS_IOMMU
	bool "EXYNOS DRM IOMMU Support"
	depends on DRM_EXYNOS && EXYNOS_IOMMU && ARM_DMA_USE_IOMMU
	help
	  Choose this option if you want to use IOMMU feature for DRM.

config DRM_EXYNOS_DMABUF
	bool "EXYNOS DRM DMABUF"
	depends on DRM_EXYNOS
	help
	  Choose this option if you want to use DMABUF feature for DRM.

config DRM_EXYNOS_FIMD
	bool "EXYNOS DRM FIMD"
	depends on DRM_EXYNOS && !FB_S3C
	help
	  Choose this option if you want to use Exynos FIMD for DRM.

config DRM_EXYNOS_HDMI
	bool "EXYNOS DRM HDMI"
	depends on DRM_EXYNOS && !VIDEO_SAMSUNG_S5P_TV
	help
	  Choose this option if you want to use Exynos HDMI for DRM.

config DRM_EXYNOS_VIDI
	bool "EXYNOS DRM Virtual Display"
	depends on DRM_EXYNOS
	help
	  Choose this option if you want to use Exynos VIDI for DRM.

config DRM_EXYNOS_IPP
	bool "EXYNOS DRM IPP"
	depends on DRM_EXYNOS
	help
	  This option enables IPP drivers for FIMC, GSC, Rotator.
	  It can support user space ioctl for each devices.
	  ipp operations support rotating and scaling, writeback, flip, output
	  when enable this options.

config DRM_EXYNOS_GSC
	bool "EXYNOS DRM GSC"
	depends on DRM_EXYNOS_IPP && !ARCH_EXYNOS4
	help
	  Choose this option if you want to use Exynos GSC for DRM.

config DRM_EXYNOS_SC
	bool "EXYNOS DRM SC"
	depends on DRM_EXYNOS_IPP && !ARCH_EXYNOS4
	help
	  Choose this option if you want to use Exynos SC for DRM.

config DRM_EXYNOS_DBG
	bool "EXYNOS DRM DBG"
	depends on DRM_EXYNOS
	help
	  Choose this option if you want to use debug feature.

config DRM_EXYNOS_IPP_TC
	bool "EXYNOS DRM IPP TRAFFIC CONTROL"
	depends on DRM_EXYNOS_IPP
	help
	  This option enables IPP drivers for traffic control.

config DRM_EXYNOS_LOGO
	bool "EXYNOS DRM LOGO"
	depends on DRM_EXYNOS
	help
	  Choose this option if you want to use logo feature.
	  It parses kernel command line to get logo information,
	  and overwrites fbdev gem ops.
```
